## perception/esp32_http_client_wifi_bmp280/main/Kconfig.projbuild
```kconfig
menu "App Settings"

config APP_WIFI_SSID
    string "WiFi SSID"
    default ""

config APP_WIFI_PASSWORD
    string "WiFi Password"
    default ""

config APP_SERVER_URL
    string "App Server URL"
    default "http://localhost:8080/measurement"

endmenu
```
